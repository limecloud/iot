## firmware/components/limeiot_espidf/Kconfig
```kconfig
config LIMEIOT_CREDENTIAL_DATE_CHECK
    bool
    default y
    select MBEDTLS_HAVE_TIME
    select MBEDTLS_HAVE_TIME_DATE
    help
        Require certificate date support for MQTT startup and runtime checks.
        The product must supply an independently trusted wall clock.

menu "LimeIoT storage"
    config LIMEIOT_NVS_HMAC_PROTECTED
        bool "Require pre-provisioned HMAC-protected NVS"
        depends on SOC_HMAC_SUPPORTED
        default n
        help
            Require the configured HMAC_UP key block to be read/write protected.
            Read an authenticated device/space binding before opening NVS.
            This adapter never generates keys or burns eFuses.
endmenu

menu "LimeIoT device identity"
    config LIMEIOT_DEVICE_LOCAL_IDENTITY
        bool "Allow device-local key and CSR initialization"
        depends on LIMEIOT_NVS_HMAC_PROTECTED
        default y
        select MBEDTLS_X509_CREATE_C
        select MBEDTLS_X509_CSR_WRITE_C
        select MBEDTLS_HAVE_TIME_DATE
        help
            Keep the device TLS private key in authenticated encrypted NVS.
            Export only a public CSR and verify pinned CA, device and key on import.
            Product code must explicitly authorize initialization operations.
endmenu
```

## firmware/products/desk-node/main/Kconfig.projbuild
```kconfig
menu "LimeIoT development node"
    config LIMEIOT_BOARD_ID
        string "Board identifier"
        default "c3-development"
        help
            Set an exact board identifier after verifying the physical board.
            The default describes the development contract, not a vendor model.
    choice LIMEIOT_ROLE
        prompt "Node role"
        default LIMEIOT_ROLE_LAMP
        config LIMEIOT_ROLE_LAMP
            bool "Lamp"
        config LIMEIOT_ROLE_BUTTON
            bool "Button"
        config LIMEIOT_ROLE_ENVIRONMENT
            bool "SHT30 temperature and humidity"
    endchoice
    config LIMEIOT_LED_GPIO
        int "WS2812 data GPIO"
        range 0 21
        default 10
        depends on LIMEIOT_ROLE_LAMP
    config LIMEIOT_LED_COUNT
        int "WS2812 pixel count"
        range 1 8
        default 1
        depends on LIMEIOT_ROLE_LAMP
    config LIMEIOT_BUTTON_GPIO
        int "Button GPIO (active low, external button)"
        range 0 21
        default 3
        depends on LIMEIOT_ROLE_BUTTON
    config LIMEIOT_SHT30_SDA_GPIO
        int "SHT30 SDA GPIO (external 3.3V pull-up required)"
        range 0 21
        default 4
        depends on LIMEIOT_ROLE_ENVIRONMENT
    config LIMEIOT_SHT30_SCL_GPIO
        int "SHT30 SCL GPIO (external 3.3V pull-up required)"
        range 0 21
        default 5
        depends on LIMEIOT_ROLE_ENVIRONMENT
    config LIMEIOT_SHT30_ADDRESS
        hex "SHT30 7-bit I2C address"
        range 0x44 0x45
        default 0x44
        depends on LIMEIOT_ROLE_ENVIRONMENT
    config LIMEIOT_DEVELOPMENT_USB_CLOCK
        bool "Allow physical USB time bootstrap for development"
        default y
        help
            Development boards without a trusted RTC require the owner to enter
            a Unix timestamp through USB after each cold boot. TLS verification
            stays enabled. Production hardware needs a protected clock adapter.
    config LIMEIOT_DEVELOPMENT_IDENTITY_MAINTENANCE
        bool "Enter explicit USB identity maintenance before MQTT"
        depends on LIMEIOT_DEVICE_LOCAL_IDENTITY
        default n
        help
            Dedicated development maintenance image. Always stop before MQTT
            until the operator enters identity continue with valid credentials.
            Allow public CSR, staged rotation, certificate import and activation
            proof. This is not a physical claim window or a production UI.
endmenu
```

## firmware/products/desk-node/sdkconfig.defaults
```kconfig
CONFIG_IDF_TARGET="esp32c3"
CONFIG_ESPTOOLPY_FLASHSIZE_4MB=y
CONFIG_PARTITION_TABLE_CUSTOM=y
CONFIG_PARTITION_TABLE_CUSTOM_FILENAME="partitions.csv"
CONFIG_BOOTLOADER_APP_ROLLBACK_ENABLE=y
CONFIG_MQTT_PROTOCOL_5=y
CONFIG_MQTT_PROTOCOL_311=n
CONFIG_ESP_CONSOLE_USB_SERIAL_JTAG=y
CONFIG_LIMEIOT_ROLE_LAMP=y
CONFIG_LIMEIOT_DEVELOPMENT_USB_CLOCK=y
```
